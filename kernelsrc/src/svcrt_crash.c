/**
* @file svcrt_crash.c
* @brief Cross-reset crash journal - see svcrt_crash.h for what it is for.
*/

#include "svcrt_crash.h"
#include "svcrt_ptable.h"
#include "svcrt_partition.h"
#include "svcrt_hal.h"
#include "svcrt_task.h"         /* svcrt_kernel_tick */
#include "svcrt_log.h"
#include "svcrt_config.h"    /* feature gates: SVCRT_USE_CRASH_LOG */

/* FNV-1a over the path bytes. Defined outside the SVCRT_USE_CRASH_LOG gate: the
 * MiniApp loader and the console both need one stable identity for a path even
 * in a build where the journal itself is compiled out (there the accounting
 * below is a no-op, but the name of a MiniApp still has to agree) . */
uint32 svcrt_crash_hash_path(const char *path)
{
    uint32 h = 2166136261u;

    if((path == 0) || (path[0] == '\0'))
    {
        return 0u;
    }

    while(*path != '\0')
    {
        h = (h ^ (uint32)(uint8)(*path)) * 16777619u;
        path++;
    }

    return (h == 0u) ? 1u : h;      /* 0 always means "empty entry" */
}

#if SVCRT_USE_CRASH_LOG

/* The journal lives in the UNINIT region the scatter file reserves at the end
 * of shared RAM (CRASH_LOG_BASE, generated by tools/gen_scatter.py).
 *
 * `section` puts it there; `zero_init` keeps it out of the initialized-data
 * class, so no startup copy can overwrite a surviving journal with the
 * compile-time zeros. The region itself is marked UNINIT, which is what makes
 * a reset leave it alone - that is the whole mechanism.
 *
 * It is not `static`: the linker places the section by name, and a file-local
 * symbol an optimizing compiler may drop is a bad bet for something whose
 * entire purpose is to have been written by an earlier run of the program. */
__attribute__((section(".noinit"), zero_init))
svcrt_crash_journal_t svcrt_crash_journal;

/* Sizing is a build-time question, not a runtime surprise: if the struct ever
 * grows past the region, the linker would quietly place the next section on
 * top of the journal. Fail the build instead. */
typedef char svcrt_crash_fits_check[
    (sizeof(svcrt_crash_journal_t) <= (uint32)CRASH_LOG_SIZE) ? 1 : -1];

/* ------------------------------------------------------------------ */

/* One word per field, FNV-1a style: cheap enough to run with interrupts off
 * (the update path runs inside the tick handler, where a 500 us period is the
 * whole budget), and strong enough for what this has to catch - leftover RAM
 * bytes standing in for a journal, and a commit cut in half by a reset.
 *
 * CRC32 was the obvious alternative and was rejected on cost: the kernel's
 * svcrt_crc32() is a bit-at-a-time routine, and running it over this record
 * would mask interrupts for roughly 200 us on every fault - a fifth of a tick
 * to protect two hundred bytes of bookkeeping. The magic and the version
 * already reject anything that is not a journal; this only has to reject
 * something that almost is one. */
static uint32 svcrt_crash_checksum(const svcrt_crash_journal_t *p_j)
{
    const uint32 *p = (const uint32 *)p_j;
    uint32 words = (uint32)(sizeof(*p_j) / sizeof(uint32)) - 1u;  /* all but `check` */
    uint32 h = 2166136261u;
    uint32 i;

    for(i = 0u; i < words; i++)
    {
        h = (h ^ p[i]) * 16777619u;
    }

    return h;
}

static void svcrt_crash_commit(void)
{
    svcrt_crash_journal.seq++;
    svcrt_crash_journal.check = svcrt_crash_checksum(&svcrt_crash_journal);
}

static int32 svcrt_crash_valid(void)
{
    const svcrt_crash_journal_t *p_j = &svcrt_crash_journal;

    if(p_j->magic != (uint32)SVCRT_CRASH_MAGIC)
    {
        return 0;
    }
    if(p_j->version != (uint32)SVCRT_CRASH_VERSION)
    {
        return 0;
    }

    return (p_j->check == svcrt_crash_checksum(p_j)) ? 1 : 0;
}

static void svcrt_crash_clear_entry(uint32 slot)
{
    svcrt_crash_journal.crash_cnt[slot]   = 0u;
    svcrt_crash_journal.last_reason[slot] = SVCRT_CRASH_REASON_NONE;
    svcrt_crash_journal.dis_reason[slot]  = SVCRT_CRASH_REASON_NONE;
    svcrt_crash_journal.dis_tick[slot]    = 0u;
    svcrt_crash_journal.base[slot]        = 0u;
}

static void svcrt_crash_clear_mini(uint32 i)
{
    svcrt_crash_journal.mini_hash[i]        = 0u;
    svcrt_crash_journal.mini_cnt[i]         = 0u;
    svcrt_crash_journal.mini_last_reason[i] = SVCRT_CRASH_REASON_NONE;
    svcrt_crash_journal.mini_dis_reason[i]  = SVCRT_CRASH_REASON_NONE;
    svcrt_crash_journal.mini_dis_tick[i]    = 0u;
}

/* Effective consecutive-fault limit, in the same precedence order the let
 * operator uses: the device-side configuration region may override the
 * compile-time default, and 0 in that region means "keep the default"
 * (svcrt_layout_def.h, fault_restart_max). It does NOT mean "no limit":
 * an unset field quietly turning the policy off is exactly the kind of
 * silent hole this module exists to close. */
static uint32 svcrt_crash_limit(void)
{
    const svcrt_partition_table_t *p_pt = svcrt_ptable_get();

    if(p_pt->cfg_restart_max != 0u)
    {
        return p_pt->cfg_restart_max;
    }

    return (uint32)APP_CRASH_RESTART_MAX;
}

/* ------------------------------------------------------------------ */

void svcrt_crash_init(void)
{
    svcrt_crash_journal_t *p_j = &svcrt_crash_journal;
    uint32 i;

    if(svcrt_crash_valid() != 0)
    {
        /* A journal from an earlier run survived the reset. Keeping it is the
         * entire point of the noinit region, so the only thing to do here is
         * note that another boot happened. */
        p_j->boots++;
        svcrt_crash_commit();
        return;
    }

    /* Never written, half written, or written by an older layout: not
     * evidence. Starting clean costs one extra crash before an image is
     * disabled; reading garbage as history could disable an image that never
     * faulted, which is the worse of the two mistakes. */
    for(i = 0u; i < (uint32)SVCRT_SLOT_ARRAY_MAX; i++)
    {
        svcrt_crash_clear_entry(i);
    }

    /* The MiniApp table is part of the same record: a journal rebuilt from
     * scratch has to start with it empty too, or leftover RAM bytes would be
     * read as "these paths already crashed N times". */
    for(i = 0u; i < (uint32)SVCRT_CRASH_MINI_MAX; i++)
    {
        svcrt_crash_clear_mini(i);
    }

    p_j->magic   = (uint32)SVCRT_CRASH_MAGIC;
    p_j->version = (uint32)SVCRT_CRASH_VERSION;
    p_j->seq     = 0u;
    p_j->boots   = 1u;
    svcrt_crash_commit();
}

void svcrt_crash_scan_apply(void)
{
    svcrt_partition_table_t *p_pt = svcrt_ptable_get();
    svcrt_crash_journal_t *p_j = &svcrt_crash_journal;
    uint32 limit = svcrt_crash_limit();
    uint32 changed = 0u;
    uint32 i;

    for(i = 0u; (i < p_pt->slot_max) && (i < (uint32)SVCRT_SLOT_ARRAY_MAX); i++)
    {
        if(p_pt->slot_type[i] == SVCRT_SLOT_FREE)
        {
            /* No image in this record: any entry left over from an uninstall
             * must not be waiting to charge the next occupant. */
            if((p_j->base[i] != 0u) || (p_j->crash_cnt[i] != 0u) ||
               (p_j->dis_reason[i] != SVCRT_CRASH_REASON_NONE))
            {
                svcrt_crash_clear_entry(i);
                changed = 1u;
            }
            continue;
        }

        if((p_pt->slot_base[i] == 0u) || (p_j->base[i] != p_pt->slot_base[i]))
        {
            /* The entry describes a different image - replaced, moved by
             * compaction, or the record was reused. Drop it rather than charge
             * a newcomer with someone else's crashes. */
            svcrt_crash_clear_entry(i);
            changed = 1u;
        }

        /* Re-tag unconditionally: from here on the entry belongs to the image
         * the scan just found, whatever it replaced. */
        p_j->base[i] = p_pt->slot_base[i];
        changed = 1u;

        p_pt->slot_crash_cnt[i] = p_j->crash_cnt[i];

        /* Two ways a slot can already be past the limit at boot:
         *   - it was disabled in a previous run and the journal survived;
         *   - it was counted by the guard just before it starved the watchdog,
         *     so the reset landed before the normal terminal path could run.
         * Both mean "this slot must not run again on its own". */
        if((p_j->dis_reason[i] != SVCRT_CRASH_REASON_NONE) ||
           ((limit != 0u) && (p_j->crash_cnt[i] >= limit)))
        {
            if(p_j->dis_reason[i] == SVCRT_CRASH_REASON_NONE)
            {
                p_j->dis_reason[i] = (p_j->last_reason[i] != SVCRT_CRASH_REASON_NONE)
                                   ? p_j->last_reason[i]
                                   : (uint32)SVCRT_CRASH_REASON_FAULT;
                p_j->dis_tick[i] = 0u;      /* disabled before this boot began */
                changed = 1u;
            }

            /* Keep the image out of this boot's autostart, and keep the state
             * the operator saw before the reset. INVALID is what "present, but
             * the kernel refuses to run it" looks like, so 'app list' cannot
             * be read as "the slot came back empty". */
            p_pt->slot_autostart[i] = 0u;
            (void)svcrt_ptable_set_slot(i, SVCRT_APP_SLOT_INVALID,
                                        p_pt->slot_entry[i], 0u);

            SVCRT_LOGE("CRASH", "slot %u held: %s, %u faults, last at tick %u"
                       " (retry with 'app start %u' or 'drv start %u')",
                       (unsigned)i,
                       svcrt_crash_reason_name(p_j->dis_reason[i]),
                       (unsigned)p_j->crash_cnt[i],
                       (unsigned)p_j->dis_tick[i],
                       (unsigned)i, (unsigned)i);
        }
    }

    if(changed != 0u)
    {
        svcrt_crash_commit();
    }
}

uint32 svcrt_crash_fault(uint32 slot, uint32 reason)
{
    svcrt_partition_table_t *p_pt = svcrt_ptable_get();
    svcrt_crash_journal_t *p_j = &svcrt_crash_journal;
    uint32 limit = svcrt_crash_limit();
    uint32 count;
    uint32 irq_state;

    if((slot >= p_pt->slot_max) || (slot >= (uint32)SVCRT_SLOT_ARRAY_MAX))
    {
        return 0u;
    }

    irq_state = SVCRT_ENTER_CRITICAL();

    /* RAM mirror first: this is what the shell and the host GUI read, and it
     * has to be right even for a slot that cannot be tagged (see below). */
    p_pt->slot_crash_cnt[slot]++;
    count = p_pt->slot_crash_cnt[slot];

    /* A slot with no pool address has no identity that would still mean
     * anything after a reset, so there is nothing honest to write down: the
     * RAM count stands, the journal stays untouched. */
    if(p_pt->slot_base[slot] != 0u)
    {
        if(p_j->base[slot] != p_pt->slot_base[slot])
        {
            /* The address changed under the entry (a re-install that reused the
             * record): the old count is not this image's, so it starts at 1. */
            svcrt_crash_clear_entry(slot);
            p_j->base[slot] = p_pt->slot_base[slot];
            p_j->crash_cnt[slot] = 0u;
        }

        p_j->crash_cnt[slot]++;
        p_j->last_reason[slot] = reason;

        if((limit != 0u) && (p_j->crash_cnt[slot] >= limit) &&
           (p_j->dis_reason[slot] == SVCRT_CRASH_REASON_NONE))
        {
            p_j->dis_reason[slot] = reason;
            p_j->dis_tick[slot]   = svcrt_kernel_tick;
        }

        svcrt_crash_commit();
    }

    SVCRT_EXIT_CRITICAL(irq_state);

    return count;
}

uint32 svcrt_crash_disabled(uint32 slot)
{
    const svcrt_partition_table_t *p_pt = svcrt_ptable_get();

    if((slot >= p_pt->slot_max) || (slot >= (uint32)SVCRT_SLOT_ARRAY_MAX))
    {
        return 0u;
    }

    return svcrt_crash_journal.dis_reason[slot];
}

uint32 svcrt_crash_disabled_tick(uint32 slot)
{
    const svcrt_partition_table_t *p_pt = svcrt_ptable_get();

    if((slot >= p_pt->slot_max) || (slot >= (uint32)SVCRT_SLOT_ARRAY_MAX))
    {
        return 0u;
    }

    return svcrt_crash_journal.dis_tick[slot];
}

uint32 svcrt_crash_count(uint32 slot)
{
    if(slot >= (uint32)SVCRT_SLOT_ARRAY_MAX)
    {
        return 0u;
    }

    return svcrt_crash_journal.crash_cnt[slot];
}

uint32 svcrt_crash_last_reason(uint32 slot)
{
    if(slot >= (uint32)SVCRT_SLOT_ARRAY_MAX)
    {
        return SVCRT_CRASH_REASON_NONE;
    }

    return svcrt_crash_journal.last_reason[slot];
}

void svcrt_crash_forget(uint32 slot)
{
    svcrt_partition_table_t *p_pt = svcrt_ptable_get();
    uint32 irq_state;

    if(slot >= (uint32)SVCRT_SLOT_ARRAY_MAX)
    {
        return;
    }

    irq_state = SVCRT_ENTER_CRITICAL();

    svcrt_crash_clear_entry(slot);

    if(slot < p_pt->slot_max)
    {
        p_pt->slot_crash_cnt[slot] = 0u;
    }

    svcrt_crash_commit();

    SVCRT_EXIT_CRITICAL(irq_state);
}

uint32 svcrt_crash_boots(void)
{
    return svcrt_crash_journal.boots;
}

uint32 svcrt_crash_seq(void)
{
    return svcrt_crash_journal.seq;
}

const char *svcrt_crash_reason_name(uint32 reason)
{
    switch(reason)
    {
        case SVCRT_CRASH_REASON_NONE:      return "none";
        case SVCRT_CRASH_REASON_FAULT:     return "crash-limit";
        case SVCRT_CRASH_REASON_HEARTBEAT: return "heartbeat";
        case SVCRT_CRASH_REASON_AUDIT:     return "audit";
        default:                           return "unknown";
    }
}

uint32 svcrt_crash_area_base(void)
{
    return (uint32)CRASH_LOG_BASE;
}

uint32 svcrt_crash_area_size(void)
{
    return (uint32)CRASH_LOG_SIZE;
}

/* ---- MiniApp bookkeeping ------------------------------------------- */

/* Index of the entry tracked for this hash, or -1. */
static int32 svcrt_crash_mini_find(uint32 hash)
{
    uint32 i;

    for(i = 0u; i < (uint32)SVCRT_CRASH_MINI_MAX; i++)
    {
        if(svcrt_crash_journal.mini_hash[i] == hash)
        {
            return (int32)i;
        }
    }

    return -1;
}

/* Pick an entry for a path that is not tracked yet: an empty one, else the
 * least-faulted entry that is not disabled (a disabled entry is operator state
 * the journal exists to keep). -1 when every entry is a disabled MiniApp. */
static int32 svcrt_crash_mini_victim(void)
{
    int32 best = -1;
    uint32 best_cnt = 0xffffffffu;
    uint32 i;

    for(i = 0u; i < (uint32)SVCRT_CRASH_MINI_MAX; i++)
    {
        if(svcrt_crash_journal.mini_hash[i] == 0u)
        {
            return (int32)i;
        }
    }

    for(i = 0u; i < (uint32)SVCRT_CRASH_MINI_MAX; i++)
    {
        if(svcrt_crash_journal.mini_dis_reason[i] != SVCRT_CRASH_REASON_NONE)
        {
            continue;
        }
        if(svcrt_crash_journal.mini_cnt[i] < best_cnt)
        {
            best_cnt = svcrt_crash_journal.mini_cnt[i];
            best = (int32)i;
        }
    }

    return best;
}

uint32 svcrt_crash_mini_fault(uint32 hash, uint32 reason)
{
    svcrt_crash_journal_t *p_j = &svcrt_crash_journal;
    uint32 limit = svcrt_crash_limit();
    uint32 irq_state;
    uint32 count;
    int32 idx;

    if(hash == 0u)
    {
        return 0u;
    }

    irq_state = SVCRT_ENTER_CRITICAL();

    idx = svcrt_crash_mini_find(hash);
    if(idx < 0)
    {
        idx = svcrt_crash_mini_victim();
    }

    if(idx < 0)
    {
        /* Every entry belongs to a disabled MiniApp: there is nowhere honest to
         * put this fault, so say so (0) rather than fabricate a count. */
        SVCRT_EXIT_CRITICAL(irq_state);
        return 0u;
    }

    if(p_j->mini_hash[idx] != hash)
    {
        /* Fresh identity, or a reused victim whose count was someone else's:
         * start this path at 1. */
        svcrt_crash_clear_mini((uint32)idx);
        p_j->mini_hash[idx] = hash;
    }

    p_j->mini_cnt[idx]++;
    p_j->mini_last_reason[idx] = reason;

    if((limit != 0u) && (p_j->mini_cnt[idx] >= limit) &&
       (p_j->mini_dis_reason[idx] == SVCRT_CRASH_REASON_NONE))
    {
        p_j->mini_dis_reason[idx] = reason;
        p_j->mini_dis_tick[idx]   = svcrt_kernel_tick;
    }

    count = p_j->mini_cnt[idx];
    svcrt_crash_commit();

    SVCRT_EXIT_CRITICAL(irq_state);

    return count;
}

uint32 svcrt_crash_mini_disabled(uint32 hash)
{
    int32 idx;

    if(hash == 0u)
    {
        return 0u;
    }

    idx = svcrt_crash_mini_find(hash);

    return (idx < 0) ? 0u : svcrt_crash_journal.mini_dis_reason[idx];
}

uint32 svcrt_crash_mini_count(uint32 hash)
{
    int32 idx;

    if(hash == 0u)
    {
        return 0u;
    }

    idx = svcrt_crash_mini_find(hash);

    return (idx < 0) ? 0u : svcrt_crash_journal.mini_cnt[idx];
}

uint32 svcrt_crash_mini_disabled_tick(uint32 hash)
{
    int32 idx;

    if(hash == 0u)
    {
        return 0u;
    }

    idx = svcrt_crash_mini_find(hash);

    return (idx < 0) ? 0u : svcrt_crash_journal.mini_dis_tick[idx];
}

uint32 svcrt_crash_mini_at(uint32 idx, uint32 *hash, uint32 *cnt,
                           uint32 *last, uint32 *hold, uint32 *tick)
{
    if(idx >= SVCRT_CRASH_MINI_MAX)
    {
        return 0u;
    }

    if(hash != 0) { *hash = svcrt_crash_journal.mini_hash[idx]; }
    if(cnt  != 0) { *cnt  = svcrt_crash_journal.mini_cnt[idx]; }
    if(last != 0) { *last = svcrt_crash_journal.mini_last_reason[idx]; }
    if(hold != 0) { *hold = svcrt_crash_journal.mini_dis_reason[idx]; }
    if(tick != 0) { *tick = svcrt_crash_journal.mini_dis_tick[idx]; }

    return (svcrt_crash_journal.mini_hash[idx] != 0u) ? 1u : 0u;
}

void svcrt_crash_mini_forget(uint32 hash)
{
    uint32 irq_state;
    int32 idx;

    if(hash == 0u)
    {
        return;
    }

    irq_state = SVCRT_ENTER_CRITICAL();

    idx = svcrt_crash_mini_find(hash);
    if(idx >= 0)
    {
        svcrt_crash_clear_mini((uint32)idx);
        svcrt_crash_commit();
    }

    SVCRT_EXIT_CRITICAL(irq_state);
}

#else   /* SVCRT_USE_CRASH_LOG == 0 */
/* Cross-reset crash journal compiled out.  Nothing is ever recorded, so
 * nothing is ever disabled by a fault count and the region has no address.
 * svcrt_crash_disabled() returning 0 keeps every reader on its normal path
 * (an image is not held back for a fault the kernel did not count). */

#include <string.h>

void svcrt_crash_init(void)
{
}

void svcrt_crash_scan_apply(void)
{
}

uint32 svcrt_crash_fault(uint32 slot, uint32 reason)
{
    (void)slot;
    (void)reason;
    return 0u;
}

uint32 svcrt_crash_disabled(uint32 slot)
{
    (void)slot;
    return 0u;
}

uint32 svcrt_crash_disabled_tick(uint32 slot)
{
    (void)slot;
    return 0u;
}

uint32 svcrt_crash_count(uint32 slot)
{
    (void)slot;
    return 0u;
}

uint32 svcrt_crash_last_reason(uint32 slot)
{
    (void)slot;
    return 0u;
}

void svcrt_crash_forget(uint32 slot)
{
    (void)slot;
}

uint32 svcrt_crash_boots(void)
{
    return 0u;
}

uint32 svcrt_crash_seq(void)
{
    return 0u;
}

const char *svcrt_crash_reason_name(uint32 reason)
{
    if(reason == 0u)
    {
        return "none";
    }
    return "crash journal disabled";
}

uint32 svcrt_crash_area_base(void)
{
    return 0u;
}

uint32 svcrt_crash_area_size(void)
{
    return 0u;
}

/* MiniApp bookkeeping compiled out: nothing is ever counted, so nothing is ever
 * disabled and the loader's DISABLED answer can never fire. The hash is still
 * real (it is just arithmetic), so callers keep sharing one identity. */
uint32 svcrt_crash_mini_fault(uint32 hash, uint32 reason)
{
    (void)hash;
    (void)reason;
    return 0u;
}

uint32 svcrt_crash_mini_disabled(uint32 hash)
{
    (void)hash;
    return 0u;
}

uint32 svcrt_crash_mini_count(uint32 hash)
{
    (void)hash;
    return 0u;
}

uint32 svcrt_crash_mini_disabled_tick(uint32 hash)
{
    (void)hash;
    return 0u;
}

uint32 svcrt_crash_mini_at(uint32 idx, uint32 *hash, uint32 *cnt,
                           uint32 *last, uint32 *hold, uint32 *tick)
{
    /* No journal exists, so no index ever holds an entry. The out-parameters
     * are still written: a caller that reads them without checking the return
     * value then reads zeroes rather than whatever was on its stack. */
    (void)idx;
    if(hash != 0) { *hash = 0u; }
    if(cnt  != 0) { *cnt  = 0u; }
    if(last != 0) { *last = 0u; }
    if(hold != 0) { *hold = 0u; }
    if(tick != 0) { *tick = 0u; }
    return 0u;
}

void svcrt_crash_mini_forget(uint32 hash)
{
    (void)hash;
}

#endif /* SVCRT_USE_CRASH_LOG */
